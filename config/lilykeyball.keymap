default_layer {
    bindings = <
        // 嵍庤
        &kp ESC    &kp N1     &kp N2     &kp N3     &kp N4     &kp N5
        &kp TAB    &kp Q      &kp W      &kp E      &kp R      &kp T
        &kp LSHFT  &kp A      &kp S      &kp D      &kp F      &kp G
        &kp LCTRL  &kp Z      &kp X      &kp C      &kp V      &kp B
        &kp LGUI   &none      &kp LALT   &kp ENTER  &kp LBRC

        // 塃庤
        &kp N6     &kp N7     &kp N8     &kp N9     &kp N0     &kp DEL
        &kp Y      &kp U      &kp I      &kp O      &kp P      &kp MINUS
        &kp H      &kp J      &kp K      &kp L      &kp SEMI   &kp SQT
        &kp N      &kp M      &kp COMMA  &kp DOT    &kp FSLH   &kp BSLH
        &kp RBRC   &kp SPACE  &kp BSPC   &none      &kp MENU
    >;
};