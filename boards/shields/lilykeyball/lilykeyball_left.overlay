// This file was generated from a template. Edit it to match your keyboard.
// See https://zmk.dev/docs/development/hardware-integration/new-shield for more
// instructions.

#include "lilykeyball.dtsi"

&kscan {
    diode-direction = "col2row";

    row-gpios
        //= <&gpio1 5 (GPIO_ACTIVE_HIGH | GPIO_PULL_DOWN)>
        //, <&gpio1 13 (GPIO_ACTIVE_HIGH | GPIO_PULL_DOWN)>
        //, <&gpio1 3 (GPIO_ACTIVE_HIGH | GPIO_PULL_DOWN)>
        //, <&gpio1 12 (GPIO_ACTIVE_HIGH | GPIO_PULL_DOWN)>
        //, <&gpio1 11 (GPIO_ACTIVE_HIGH | GPIO_PULL_DOWN)>

        = <&gpio0 2 GPIO_ACTIVE_LOW>
        , <&gpio0 3 GPIO_ACTIVE_LOW>
        , <&gpio0 28 GPIO_ACTIVE_LOW>
        , <&gpio0 29 GPIO_ACTIVE_LOW>
        , <&gpio0 4 GPIO_ACTIVE_LOW>
        ;

    col-gpios
        //= <&gpio1 1 (GPIO_ACTIVE_HIGH | GPIO_PULL_DOWN)>
        //, <&gpio0 28 (GPIO_ACTIVE_HIGH | GPIO_PULL_DOWN)>
        //, <&gpio0 19 (GPIO_ACTIVE_HIGH | GPIO_PULL_DOWN)>
        //, <&gpio0 3 (GPIO_ACTIVE_HIGH | GPIO_PULL_DOWN)>
        //, <&gpio0 15 (GPIO_ACTIVE_HIGH | GPIO_PULL_DOWN)>
        //, <&gpio0 2 (GPIO_ACTIVE_HIGH | GPIO_PULL_DOWN)>

        = <&gpio1 15 GPIO_ACTIVE_LOW>
        , <&gpio1 14 GPIO_ACTIVE_LOW>
        , <&gpio1 13 GPIO_ACTIVE_LOW>
        , <&gpio1 12 GPIO_ACTIVE_LOW>
        , <&gpio0 15 (GPIO_ACTIVE_HIGH | GPIO_PULL_DOWN)>
        , <&gpio0 2 (GPIO_ACTIVE_HIGH | GPIO_PULL_DOWN)>

        ;
};