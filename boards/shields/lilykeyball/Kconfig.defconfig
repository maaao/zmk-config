## boards/shields/lilykeyball/Kconfig.defconfig
```kconfig
if SHIELD_LILYKEYBALL_RIGHT

config ZMK_KEYBOARD_NAME
    default "lilyKeyBall"

config ZMK_SPLIT_ROLE_CENTRAL
    default y

endif # SHIELD_LILYKEYBALL_RIGHT

if SHIELD_LILYKEYBALL_LEFT || SHIELD_LILYKEYBALL_RIGHT

config ZMK_SPLIT
    default y

endif # SHIELD_LILYKEYBALL_LEFT || SHIELD_LILYKEYBALL_RIGHT
```

## boards/shields/lilykeyball/Kconfig.shield
```kconfig
config SHIELD_LILYKEYBALL_LEFT
    def_bool $(shields_list_contains,lilykeyball_left)

config SHIELD_LILYKEYBALL_RIGHT
    def_bool $(shields_list_contains,lilykeyball_right)
```

## config/west.yml
```yaml
manifest:
  defaults:
    revision: v0.3
  remotes:
    - name: zmkfirmware
      url-base: https://github.com/zmkfirmware
      
    # - name: KOHSUK
    #   url-base: https://github.com/KOHSUK
    - name: maaao
      url-base: https://github.com/maaao
    - name: sekigon-gonnoc
      url-base: https://github.com/sekigon-gonnoc

    # Additional modules containing boards/shields/custom code can be listed here as well
    # See https://docs.zephyrproject.org/3.2.0/develop/west/manifest.html#projects
  projects:
    - name: zmk
      remote: zmkfirmware
      import: app/west.yml

    # - name: zmk-pmw3360-driver
    #   remote: KOHSUK
    #   revision: pmw3360
    - name: pmw3360-driver
      remote: maaao
      revision: master

    - name: zmk-duplex-matrix-driver
      remote: maaao
      revision: master

    - name: zmk-component-bmp-boost
      remote: sekigon-gonnoc
      revision: master
      import: west.yml


  self:
    path: config
```
